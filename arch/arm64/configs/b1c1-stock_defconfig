## drivers/block/zram/Kconfig
```kconfig
config ZRAM
	tristate "Compressed RAM block device support"
	depends on BLOCK && SYSFS && CRYPTO
	select ZPOOL
	default n
	help
	  Creates virtual block devices called /dev/zramX (X = 0, 1, ...).
	  Pages written to these disks are compressed and stored in memory
	  itself. These disks allow very fast I/O and compression provides
	  good amounts of memory savings.

	  It has several use cases, for example: /tmp storage, use as swap
	  disks and maybe many more.

	  See Documentation/blockdev/zram.txt for more information.

config ZRAM_WRITEBACK
       bool "Write back incompressible page to backing device"
       depends on ZRAM
       default n
       help
	 With incompressible page, there is no memory saving to keep it
	 in memory. Instead, write it out to backing device.
	 For this feature, admin should set up backing device via
	 /sys/block/zramX/backing_dev.

	 See Documentation/blockdev/zram.txt for more information.

config ZRAM_MEMORY_TRACKING
	bool "Track zRam block status"
	depends on ZRAM && DEBUG_FS
	help
	  With this feature, admin can track the state of allocated blocks
	  of zRAM. Admin could see the information via
	  /sys/kernel/debug/zram/zramX/block_state.

	  See Documentation/blockdev/zram.txt for more information.

if ZRAM

choice
	prompt "Default zRAM compressed memory allocator"
	default ZRAM_DEFAULT_ZSMALLOC
	help
	  Select the compressed memory allocator that will be used by default
	  for all devices.

	config ZRAM_DEFAULT_ZBUD
		bool "zbud"
		select ZBUD

	config ZRAM_DEFAULT_Z3FOLD
		bool "z3fold"
		select Z3FOLD

	config ZRAM_DEFAULT_ZSMALLOC
		bool "zsmalloc"
		select ZSMALLOC

endchoice

config ZRAM_DEFAULT_POOL
	string
	default "zbud" if ZRAM_DEFAULT_ZBUD
	default "z3fold" if ZRAM_DEFAULT_Z3FOLD
	default "zsmalloc" if ZRAM_DEFAULT_ZSMALLOC

choice
	prompt "Default zRAM compressor"
	default ZRAM_DEFAULT_LZ4
	help
	  Select the page compressor that will be used by default for all devices.

	config ZRAM_DEFAULT_LZO
		bool "LZO"
		select CRYPTO_LZO

	config ZRAM_DEFAULT_LZ4
		bool "LZ4"
		select CRYPTO_LZ4

	config ZRAM_DEFAULT_LZ4HC
		bool "LZ4HC"
		select CRYPTO_LZ4HC

	config ZRAM_DEFAULT_ZSTD
		bool "Zstd"
		select CRYPTO_ZSTD

	config ZRAM_DEFAULT_DEFLATE
		bool "Deflate"
		select CRYPTO_DEFLATE
endchoice

config ZRAM_DEFAULT_COMPRESSOR
	string
	default "lzo" if ZRAM_DEFAULT_LZO
	default "lz4" if ZRAM_DEFAULT_LZ4
	default "lz4hc" if ZRAM_DEFAULT_LZ4HC
	default "zstd" if ZRAM_DEFAULT_ZSTD
	default "deflate" if ZRAM_DEFAULT_DEFLATE

endif
```

## kernel/Kconfig.hz
```kconfig
#
# Timer Interrupt Frequency Configuration
#

config HZ
	int "Timer frequency"
	default "250"
	range 12 12288
	help
	  Allows the configuration of the timer frequency. It is customary
	  to have the timer interrupt run at 1000 Hz but 100 Hz may be more
	  beneficial for servers and NUMA systems that do not need to have
	  a fast response for user interaction and that may experience bus
	  contention and cacheline bounces as a result of timer interrupts.
	  Note that the timer interrupt occurs on each processor in an SMP
	  environment leading to NR_CPUS * HZ number of timer interrupts
	  per second.

	  The following values are known-to-work choices that are standard
	  or have been tested:
	    100 Hz is a typical choice for servers, SMP and NUMA systems
	    with lots of processors that may show reduced performance if
	    too many timer interrupts are occurring.

	    250 Hz is a good compromise choice allowing server performance
	    while also showing good interactive responsiveness even
	    on SMP and NUMA systems. If you are going to be using NTSC video
	    or multimedia, selected 300Hz instead.

	    300 Hz is a good compromise choice allowing server performance
	    while also showing good interactive responsiveness even
	    on SMP and NUMA systems and exactly dividing by both PAL and
	    NTSC frame rates for video and multimedia work.

	    400 Hz is a balanced timer frequency that can provide exact jiffy
	    lengths while not sacrificing battery life or causing increased
	    thermal output on mobile devices.

	    500 Hz is a balanced timer frequency. Provides fast interactivity
	    on desktops with great smoothness without increasing CPU power
	    consumption and sacrificing the battery life on laptops.

	    1000 Hz is the preferred choice for desktop systems and other
	    systems requiring fast interactive responses to events.

config SCHED_HRTICK
	def_bool HIGH_RES_TIMERS
```
